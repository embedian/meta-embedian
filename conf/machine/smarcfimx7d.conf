## conf/machine/smarcfimx7d.conf
```bitbake
#@TYPE: Machine
#@NAME: EMBEDIAN i.MX7D SMARC CPU Card
#@SOC: i.MX7D
#@DESCRIPTION: Machine configuration for Embedian i.MX7D SMARC CPU Card
#@MAINTAINER: Eric Lee <eric.lee@embedian.com>

MACHINEOVERRIDES =. "mx7:mx7d:"

require conf/machine/include/imx-base.inc
include conf/machine/include/arm/armv7a/tune-cortexa7.inc

SERIAL_CONSOLES = "115200;ttymxc2"

MACHINE_FIRMWARE:append = " linux-firmware-ath10k"

MACHINE_FEATURES += " pci wifi bluetooth screen usbgadget vfat ext2 alsa serial usbhost"

IMAGE_FEATURES += "package-management"

PREFERRED_PROVIDER_virtual/kernel:use-nxp-bsp ??= "linux-imx"

KERNEL_DEVICETREE = "imx7d-smarc.dtb \
                     "

PREFERRED_PROVIDER_u-boot:use-nxp-bsp = "u-boot-imx"
PREFERRED_PROVIDER_virtual/bootloader:use-nxp-bsp = "u-boot-imx"

UBOOT_CONFIG ??= "sd"
UBOOT_CONFIG[sd] = "smarcfimx7d_ser3_defconfig,sdcard"

OPTEE_BIN_EXT = "7dsmarc"

MACHINE_EXTRA_RRECOMMENDS += " \
	u-boot-imx \
	packagegroup-tools-bluetooth \
	pm-utils \
	kmod \
	hdparm \
	gptfdisk \
	lftp \
	vim \
	ntp \
	boost \
	nodejs \
	networkmanager \
	android-tools \
"

IMAGE_INSTALL:append = " \
	firmware-imx-sdma-imx6q \
	firmware-imx-sdma-imx7d \
	linux-firmware-nxp89xx \
	nxp-wlan-sdk \
	kernel-module-nxp89xx \
	ppp \
	usb-modeswitch-data \
	usb-modeswitch \
"

IMAGE_FSTYPES = "tar.bz2"
```

## conf/machine/smarcimx8mq2g.conf
```bitbake
#@TYPE: Machine
#@NAME: EMBEDIAN SMARC-iMX8MQ CPU Module with 2GB LPDDR4
#@SOC: i.MX8MQ
#@DESCRIPTION: Machine configuration for Embedian SMARC-iMX8MQ CPU Module
#@MAINTAINER: Eric Lee <eric.lee@embedian.com>

MACHINEOVERRIDES =. "mx8mq:imx-boot-container:"

require conf/machine/include/imx-base.inc
require conf/machine/include/arm/armv8a/tune-cortexa53.inc

MACHINE_SOCARCH_FILTER:append:mx8mq = " virtual/libopenvg virtual/libgles1 virtual/libgles2 virtual/egl virtual/mesa virtual/libgl virtual/libg2d"

# The device tree name is implicit for LPDDR4, so can't use MACHINE here
KERNEL_DEVICETREE_BASENAME = "imx8mq-smarc"

PREFERRED_PROVIDER_virtual/kernel:use-nxp-bsp ??= "linux-imx"

# NXP kernel has additional DTB files for various board configuration and
# derivates. Include them here for NXP BSP only

KERNEL_DEVICETREE = " \
	embedian/${KERNEL_DEVICETREE_BASENAME}.dtb \
"
KERNEL_DEVICETREE:append:use-nxp-bsp = " \
	embedian/${KERNEL_DEVICETREE_BASENAME}-hdmi.dtb \
	embedian/${KERNEL_DEVICETREE_BASENAME}-dp.dtb \
	embedian/${KERNEL_DEVICETREE_BASENAME}-dcss-lvds.dtb \
	embedian/${KERNEL_DEVICETREE_BASENAME}-lcdif-lvds.dtb \
	embedian/${KERNEL_DEVICETREE_BASENAME}-dual-display.dtb \
	embedian/${KERNEL_DEVICETREE_BASENAME}-m4.dtb \
	embedian/${KERNEL_DEVICETREE_BASENAME}-m4-hdmi.dtb \
	embedian/${KERNEL_DEVICETREE_BASENAME}-m4-dp.dtb \
	embedian/${KERNEL_DEVICETREE_BASENAME}-m4-dcss-lvds.dtb \
	embedian/${KERNEL_DEVICETREE_BASENAME}-m4-lcdif-lvds.dtb \
	embedian/${KERNEL_DEVICETREE_BASENAME}-m4-dual-display.dtb \
"

PREFERRED_PROVIDER_u-boot:use-nxp-bsp = "u-boot-imx"
PREFERRED_PROVIDER_virtual/bootloader:use-nxp-bsp = "u-boot-imx"

UBOOT_SUFFIX = "bin"

UBOOT_CONFIG ??= "sd"

SPL_BINARY = "spl/u-boot-spl.bin"

ATF_PLATFORM = "imx8mq"

UBOOT_CONFIG_BASENAME = "smarcimx8mq"
UBOOT_CONSOLE_BASENAME = "ser3"
LPDDR4_BASENAME = "2g"
UBOOT_CONFIG[sd] = "${UBOOT_CONFIG_BASENAME}_${LPDDR4_BASENAME}_${UBOOT_CONSOLE_BASENAME}_defconfig,sdcard"

# Set DDR FIRMWARE
DDR_FIRMWARE_NAME = " \
	lpddr4_pmu_train_1d_imem.bin \
	lpddr4_pmu_train_1d_dmem.bin \
	lpddr4_pmu_train_2d_imem.bin \
	lpddr4_pmu_train_2d_dmem.bin \
"

# Set u-boot DTB
UBOOT_DTB_NAME = "imx8mq-smarc.dtb"

# Set ATF platform name
ATF_PLATFORM = "imx8mq"

IMXBOOT_TARGETS = "flash_evk flash_evk_no_hdmi flash_dp_evk"
IMX_BOOT_SOC_TARGET = "iMX8M"

# Set Serial console
SERIAL_CONSOLES = "115200;ttymxc0"

# Overrides for smarcimx8mq2g
MACHINE_FEATURES:append = " pci wifi bluetooth usbgadget vfat ext2 alsa serial optee nxp8997 jailhouse"

IMAGE_FEATURES:append = "package-management"

WKS_FILE_DEPENDS:append = " imx-m4-demos"
IMAGE_BOOT_FILES:append = " \
    imx8mq_m4_TCM_hello_world.bin \
    imx8mq_m4_TCM_rpmsg_lite_pingpong_rtos_linux_remote.bin \
    imx8mq_m4_TCM_rpmsg_lite_str_echo_rtos.bin \
"

MACHINE_EXTRA_RRECOMMENDS += " \
	imx-boot \
	packagegroup-tools-bluetooth \
	pm-utils \
	kmod \
	hdparm \
	gptfdisk \
	lftp \
	vim \
	ntp \
	boost \
	nodejs \
	networkmanager \
	android-tools \
"

IMAGE_INSTALL:append = " \
	firmware-imx-sdma-imx6q \
	firmware-imx-sdma-imx7d \
	linux-firmware-nxp89xx \
	nxp-wlan-sdk \
	kernel-module-nxp89xx \
	ppp \
	usb-modeswitch-data \
	usb-modeswitch \
"

LOADADDR = ""
UBOOT_MAKE_TARGET = ""
IMX_BOOT_SEEK = "33"

OPTEE_BIN_EXT = "8mq"

IMAGE_FSTYPES = "tar.bz2"
```

## conf/machine/smarcimx8qm8g.conf
```bitbake
#@TYPE: Machine
#@NAME: EMBEDIAN SMARC-iMX8QM CPU Module with 8GB LPDDR4
#@SOC: i.MX8QM
#@DESCRIPTION: Machine configuration for Embedian i.MX 8QuadMax SMARC card
#@MAINTAINER: Eric Lee <eric.lee@embedian.com>

MACHINEOVERRIDES =. "mx8:mx8qm:"

require conf/machine/include/imx-base.inc
require conf/machine/include/arm/armv8a/tune-cortexa72-cortexa53.inc

IMX_DEFAULT_BSP = "nxp"

MACHINE_FEATURES += "pci"
MACHINE_FEATURES:append:use-nxp-bsp = " wifi bluetooth usbgadget vfat ext2 alsa serial optee nxp8997"

# Don't include kernels in standard images
RRECOMMENDS:${KERNEL_PACKAGE_NAME}-base = ""

PREFERRED_PROVIDER_virtual/kernel:use-nxp-bsp ??= "linux-imx"

LOADADDR = ""

# We have to disable SERIAL_CONSOLE due to auto-serial-console
SERIAL_CONSOLES = "115200;ttyAMA0"

# we do not want to have getty running on tty1 as we run
# auto-serial-console there
USE_VT = "0"

KERNEL_DEVICETREE = " \
	embedian/imx8qm-smarc.dtb \
	embedian/imx8qm-smarc-lvds.dtb \
	embedian/imx8qm-smarc-hdmi.dtb \
	embedian/imx8qm-smarc-dp.dtb \
	embedian/imx8qm-smarc-rpmsg.dtb \
	embedian/imx8qm-smarc-edp.dtb \
"

UBOOT_MAKE_TARGET = \
    "${@bb.utils.contains('MACHINE_FEATURES', 'optee', '', \
                                                       'u-boot.bin', d)}"
SPL_BINARY = \
    "${@bb.utils.contains('MACHINE_FEATURES', 'optee', 'spl/u-boot-spl.bin', \
                                                       '', d)}"
IMX_DEFAULT_BOOTLOADER:use-nxp-bsp = "u-boot-imx"
IMX_DEFAULT_BOOTLOADER:use-mainline-bsp = "u-boot-fslc"

UBOOT_SUFFIX = "bin"

UBOOT_CONFIG_BASENAME = "smarcimx8qm"
UBOOT_CONSOLE_BASENAME = "ser3"
LPDDR4_BASENAME = "8g"
UBOOT_CONFIG ??= "sd"
UBOOT_CONFIG[sd]      = "${UBOOT_CONFIG_BASENAME}_${LPDDR4_BASENAME}_${UBOOT_CONSOLE_BASENAME}_defconfig,sdcard"

IMX_BOOT_SEEK = "32"

IMAGE_BOOT_FILES += "hdmitxfw.bin hdmirxfw.bin dpfw.bin"

# Set ATF platform name
ATF_PLATFORM = "imx8qm"

IMXBOOT_TARGETS_SD = \
    "${@bb.utils.contains('MACHINE_FEATURES', 'optee', 'flash_spl', \
                                                       'flash_linux_m4', d)}"
IMXBOOT_TARGETS = \
    "${@bb.utils.contains('UBOOT_CONFIG',        'sd', '${IMXBOOT_TARGETS_SD}', 	'', d)}"

IMX_BOOT_SOC_TARGET = "iMX8QM"

BOARD_TYPE = "smarc-8g"

MACHINE_EXTRA_RRECOMMENDS += " \
        imx-boot \
        packagegroup-tools-bluetooth \
        pm-utils \
        kmod \
        hdparm \
        gptfdisk \
        lftp \
        vim \
        ntp \
        boost \
        nodejs \
        networkmanager \
        android-tools \
"

IMAGE_INSTALL:append = " \
        firmware-imx-sdma-imx6q \
        firmware-imx-sdma-imx7d \
        linux-firmware-nxp89xx \
        nxp-wlan-sdk \
        kernel-module-nxp89xx \
        ppp \
        usb-modeswitch-data \
        usb-modeswitch \
"

IMAGE_FSTYPES = "tar.bz2"
```
