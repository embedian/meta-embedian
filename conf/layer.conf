## conf/layer.conf
```bitbake
# We have a conf and classes directory, add to BBPATH
BBPATH .= ":${LAYERDIR}"

# We have a packages directory, add to BBFILES
BBFILES += "${LAYERDIR}/recipes-*/*/*.bb \
            ${LAYERDIR}/recipes-*/*/*.bbappend"

BBFILE_COLLECTIONS += "emb-bsp-release"
BBFILE_PATTERN_emb-bsp-release := "^${LAYERDIR}/"
BBFILE_PRIORITY_emb-bsp-release = "12"
LAYERSERIES_COMPAT_emb-bsp-release = "mickledore nanbield scarthgap"

# Create a mirror for unreliable packages
MIRRORS += "http://sourceforge.net/.* http://www.nxp.com/lgfiles/updates/other"

# Define new EULAs and add them to the list defined in meta-freescale.
# See fsl-eula-unpack.bbclass.
FSL_EULA_FILE_MD5SUM_LA_OPT_NXP_SOFTWARE_LICENSE_V49 = "2827219e81f28aba7c6a569f7c437fa7"
FSL_EULA_FILE_MD5SUM_LA_OPT_NXP_SOFTWARE_LICENSE_V53 = "44a8052c384584ba09077e85a3d1654f"
FSL_EULA_FILE_MD5SUM_LA_OPT_NXP_SOFTWARE_LICENSE_V54 = "1142bc333cf4971d6b10bd8292363f02"
FSL_EULA_FILE_MD5SUM_LA_OPT_NXP_SOFTWARE_LICENSE_V56 = "10c0fda810c63b052409b15a5445671a"
FSL_EULA_FILE_MD5SUM_LA_OPT_NXP_SOFTWARE_LICENSE_V57 = "ca53281cc0caa7e320d4945a896fb837"

FSL_EULA_FILE_MD5SUMS:append = " \
    ${FSL_EULA_FILE_MD5SUM_LA_OPT_NXP_SOFTWARE_LICENSE_V49} \
    ${FSL_EULA_FILE_MD5SUM_LA_OPT_NXP_SOFTWARE_LICENSE_V53} \
    ${FSL_EULA_FILE_MD5SUM_LA_OPT_NXP_SOFTWARE_LICENSE_V54} \
    ${FSL_EULA_FILE_MD5SUM_LA_OPT_NXP_SOFTWARE_LICENSE_V56} \
    ${FSL_EULA_FILE_MD5SUM_LA_OPT_NXP_SOFTWARE_LICENSE_V57} \
"

# Override the EULA defined in meta-freescale.
FSL_EULA_FILE = "${LAYERDIR}/../LICENSE.txt"
FSL_EULA_FILE_MD5SUM = "${FSL_EULA_FILE_MD5SUM_LA_OPT_NXP_SOFTWARE_LICENSE_V57}"

# FIXME: Drop these lines when the external layers are marked compatible
LAYERSERIES_COMPAT_chromium-browser-layer:append = " scarthgap"
LAYERSERIES_COMPAT_imx-demo:append = " scarthgap"

# FIXME: Drop xxd if/when xxd-native can be used instead
HOSTTOOLS_NONFATAL:append = " xxd cert-to-efi-sig-list"

# optee is no longer a valid distro feature. Use machine feature to remove, like this:
# MACHINE_FEATURES:remove = "optee"
# DEPRECATED: The ability to remove optee from the build is deprecated and
# will be removed in some future release.

MACHINE_USES_VIVANTE_KERNEL_DRIVER_MODULE ?= "0"

SRC_URI:remove:pn-cryptodev-module = "file://fix-build-for-Linux-6.7-rc1.patch"

# Overrides for imx-base.inc

IMX_USE_LINUX_FIRMWARE_SDMA = "0"

UBOOT_MAKE_TARGET:pn-u-boot-imx:mx6-nxp-bsp = "u-boot.imx"
UBOOT_MAKE_TARGET:pn-u-boot-imx:mx7-nxp-bsp = "u-boot.imx"
UBOOT_SUFFIX:pn-u-boot-imx:mx6-nxp-bsp = "imx"
UBOOT_SUFFIX:pn-u-boot-imx:mx7-nxp-bsp = "imx"
UBOOT_SUFFIX:pn-u-boot-imx:mx8-nxp-bsp = "bin"
UBOOT_MAKE_TARGET:pn-u-boot-imx-mfgtool:mx6-nxp-bsp = "u-boot.imx"
UBOOT_MAKE_TARGET:pn-u-boot-imx-mfgtool:mx7-nxp-bsp = "u-boot.imx"
UBOOT_SUFFIX:pn-u-boot-imx-mfgtool:mx6-nxp-bsp = "imx"
UBOOT_SUFFIX:pn-u-boot-imx-mfgtool:mx7-nxp-bsp = "imx"
UBOOT_SUFFIX:pn-u-boot-imx-mfgtool:mx8-nxp-bsp = "bin"

IMX_DEFAULT_UBOOTTOOLS = "u-boot-imx-tools"
PREFERRED_PROVIDER_u-boot-tools-native = "${IMX_DEFAULT_UBOOTTOOLS}-native"
PREFERRED_PROVIDER_nativesdk-u-boot-tools = "nativesdk-${IMX_DEFAULT_UBOOTTOOLS}"
PREFERRED_PROVIDER_u-boot-mkimage-native = "${IMX_DEFAULT_UBOOTTOOLS}-native"
PREFERRED_PROVIDER_nativesdk-u-boot-mkimage = "nativesdk-${IMX_DEFAULT_UBOOTTOOLS}"

PREFERRED_RPROVIDER_linux-firmware-bcm4359-pcie ??= "linux-firmware"
PREFERRED_RPROVIDER_u-boot-default-env ??= "${IMX_DEFAULT_BOOTLOADER}"

MACHINE_SOCARCH_FILTER:remove = "alsa-lib gstreamer1.0 imx-codec"

# Use latest SDMA firmware from firmware-imx instead of upstream linux-firmware
MACHINE_FIRMWARE:remove:mx6-nxp-bsp      = "linux-firmware-imx-sdma-imx6q"
MACHINE_FIRMWARE:remove:mx7d-nxp-bsp     = "linux-firmware-imx-sdma-imx7d"
MACHINE_FIRMWARE:remove:mx8-nxp-bsp      = "linux-firmware-imx-sdma-imx7d"
MACHINE_FIRMWARE:append:mx6-nxp-bsp      = " firmware-imx-sdma-imx6q"
MACHINE_FIRMWARE:append:mx7-nxp-bsp      = " firmware-imx-sdma-imx7d"
MACHINE_FIRMWARE:append:mx8-nxp-bsp      = " firmware-imx-sdma-imx7d"

MACHINE_FIRMWARE:append:mx8qm-nxp-bsp  = " firmware-imx-hdmi firmware-imx-xuvi-imx8 sof-zephyr zephyr-demo-imx"
MACHINE_FIRMWARE:remove:mx8mp-nxp-bsp  = "firmware-sof-imx"
MACHINE_FIRMWARE:append:mx8mp-nxp-bsp  = " sof-zephyr zephyr-demo-imx"
MACHINE_FIRMWARE:append:mx95-nxp-bsp  = " sof-zephyr"

# NXP WiFi firmware & extra Wlan SDK
MACHINE_EXTRA_RRECOMMENDS:append = " ${@bb.utils.contains('MACHINE_FEATURES', 'nxpiw416-sdio', 'nxp-wlan-sdk', '', d)}"
MACHINE_EXTRA_RRECOMMENDS:append = " ${@bb.utils.contains('MACHINE_FEATURES', 'nxpiw612-sdio', 'nxp-wlan-sdk', '', d)}"

MACHINE_FIRMWARE:append = " ${@bb.utils.contains('MACHINE_FEATURES', 'nxpwifi-all-sdio', 'firmware-nxp-wifi-all-sdio', '', d)}"
MACHINE_EXTRA_RRECOMMENDS:append = " ${@bb.utils.contains('MACHINE_FEATURES', 'nxpwifi-all-sdio', 'nxp-wlan-sdk kernel-module-nxp-wlan', '', d)}"

MACHINE_FIRMWARE:append = " ${@bb.utils.contains('MACHINE_FEATURES', 'nxpwifi-all-pcie', 'firmware-nxp-wifi-all-pcie', '', d)}"
MACHINE_EXTRA_RRECOMMENDS:append = " ${@bb.utils.contains('MACHINE_FEATURES', 'nxpwifi-all-pcie', 'nxp-wlan-sdk kernel-module-nxp-wlan', '', d)}"

# MCore Demo apps to /lib/firmware
MACHINE_EXTRA_RRECOMMENDS:append:mx8mm-nxp-bsp   = " imx-m4-demos"
MACHINE_EXTRA_RRECOMMENDS:append:mx8mp-nxp-bsp   = " imx-m7-demos"
MACHINE_EXTRA_RRECOMMENDS:append:mx8mq-nxp-bsp   = " imx-m4-demos"
MACHINE_EXTRA_RRECOMMENDS:append:mx8qm-nxp-bsp   = " imx-m4-demos"
MACHINE_EXTRA_RRECOMMENDS:append:mx93-nxp-bsp    = " imx-m33-demos"
MACHINE_EXTRA_RRECOMMENDS:append:mx95-nxp-bsp    = " imx-m7-demos"

MACHINE_GSTREAMER_1_0_PLUGIN:mx6dl-nxp-bsp ?= "imx-gst1.0-plugin"
MACHINE_GSTREAMER_1_0_PLUGIN:mx6q-nxp-bsp ?= "imx-gst1.0-plugin"
MACHINE_GSTREAMER_1_0_PLUGIN:mx7d-nxp-bsp ?= "imx-gst1.0-plugin"
MACHINE_GSTREAMER_1_0_PLUGIN:mx8mm-nxp-bsp  ?= "imx-gst1.0-plugin"
MACHINE_GSTREAMER_1_0_PLUGIN:mx8mp-nxp-bsp  ?= "imx-gst1.0-plugin"
MACHINE_GSTREAMER_1_0_PLUGIN:mx8mq-nxp-bsp  ?= "imx-gst1.0-plugin"
MACHINE_GSTREAMER_1_0_PLUGIN:mx8qm-nxp-bsp  ?= "imx-gst1.0-plugin"
MACHINE_GSTREAMER_1_0_PLUGIN:mx8-nxp-bsp ?= "imx-gst1.0-plugin"
MACHINE_GSTREAMER_1_0_PLUGIN:mx9-nxp-bsp ?= "imx-gst1.0-plugin"

OPTEE_BOOT_IMAGE:mx6-nxp-bsp ?= "tee.bin uTee-${OPTEE_BIN_EXT}"
OPTEE_BOOT_IMAGE:mx7-nxp-bsp ?= "tee.bin uTee-${OPTEE_BIN_EXT}"
OPTEE_BOOT_IMAGE:mx8-nxp-bsp ?= "tee.bin"

IMAGE_INSTALL:append = " \
    ${@bb.utils.contains('COMBINED_FEATURES', 'jailhouse', 'jailhouse', '', d)} \
    ${@bb.utils.contains('MACHINE_FEATURES', 'optee', 'packagegroup-fsl-optee-imx', '', d)} \
    ${@bb.utils.contains('COMBINED_FEATURES', 'xen', 'xen xen-tools', '', d)} \
"

# To add a new array override for a specific upstream machine, set the
# array value with a variable, then set the default variable value to
# UNSUPPORTED and the machine-specific variable value as required.
# For example:
#   UBOOT_CONFIG[fspi] = "${UBOOT_CONFIG_FSPI}"
#   UBOOT_CONFIG_FSPI                   = "UNSUPPORTED"
#   UBOOT_CONFIG_FSPI:imx8dxl-ddr3l-evk = "${UBOOT_CONFIG_BASENAME}_fspi_defconfig"

MACHINE_FEATURES_IMX_REMOVALS ?= "mrvl8997"
MACHINE_FEATURES:remove        = "${MACHINE_FEATURES_IMX_REMOVALS}"

IMXBOOT_TARGETS:append:mx8m-nxp-bsp = \
    "${@bb.utils.contains('MACHINE_FEATURES', 'optee stmm', ' flash_evk_stmm_capsule', \
                                                            '', d)}"
IMXBOOT_TARGETS:append:mx93-nxp-bsp = \
     "${@bb.utils.contains('MACHINE_FEATURES', 'stmm', ' flash_singleboot_stmm_capsule', \
                                                             '', d)}"
```

## conf/machine/include/smarc-common.inc
```bitbake
DISTRO_FEATURES_FILTER_NATIVESDK += "wayland"

MACHINE_USES_VIVANTE_KERNEL_DRIVER_MODULE ?= "0"

# Overrides for imx-base.inc
DEFAULTTUNE_mx8mp ?= "cortexa53-crypto"

IMX_DEFAULT_BSP = "nxp"

MACHINE_SOCARCH_FILTER_remove = "alsa-lib gstreamer1.0 imx-codec"

# Use latest SDMA firmware from firmware-imx instead of upstream linux-firmware
MACHINE_FIRMWARE_remove_mx8 = "linux-firmware-imx-sdma-imx7d"

MACHINE_FIRMWARE_append_mx8    = " linux-firmware-ath10k firmware-imx-sdma firmware-imx-regulatory"
MACHINE_FIRMWARE_remove_mx8mp  = "firmware-imx-easrc-imx8mn firmware-imx-xcvr-imx8mp firmware-sof-imx"
MACHINE_FIRMWARE_append_mx8mp  = " firmware-imx-easrc firmware-imx-xcvr sof-imx"

# NXP WiFi firmware & extra Wlan SDK
MACHINE_FIRMWARE_append = " ${@bb.utils.contains('MACHINE_FEATURES', 'nxp8987', 'linux-firmware-nxp89xx', '', d)}"
MACHINE_FIRMWARE_append = " ${@bb.utils.contains('MACHINE_FEATURES', 'nxp8997', 'linux-firmware-nxp89xx', '', d)}"
MACHINE_EXTRA_RRECOMMENDS_append = " ${@bb.utils.contains('MACHINE_FEATURES', 'nxp8987', 'nxp-wlan-sdk kernel-module-nxp89xx', '', d)}"
MACHINE_EXTRA_RRECOMMENDS_append = " ${@bb.utils.contains('MACHINE_FEATURES', 'nxp8997', 'nxp-wlan-sdk kernel-module-nxp89xx', '', d)}"

# MCore Demo apps to /lib/firmware
MACHINE_EXTRA_RRECOMMENDS_append_mx8mp  = " imx-m7-demos"

MACHINE_GSTREAMER_1_0_PLUGIN_mx8 ?= "imx-gst1.0-plugin"

PREFERRED_VERSION_weston_mx8 ?= "9.0.0.imx"

PREFERRED_VERSION_wayland-protocols_mx8 = "1.20.imx"

PREFERRED_VERSION_libdrm_mx8 ?= "2.4.102.imx"

PREFERRED_VERSION_isp-imx ?= "4.2.2.6.1"
PREFERRED_VERSION_basler-camera ?= "4.2.2.6.1"

PREFERRED_VERSION_optee-client_mx8 = "3.10.0.imx"
PREFERRED_VERSION_optee-os_mx8 = "3.10.0.imx"
PREFERRED_VERSION_optee-test_mx8 = "3.10.0.imx"

SOC_DEFAULT_IMAGE_FSTYPES_remove = "wic.gz"
SOC_DEFAULT_IMAGE_FSTYPES_append = " wic.bz2 tar.bz2"

OPTEE_BOOT_IMAGE_mx8 ?= "tee.bin"

IMAGE_BOOT_FILES_append = " \
    ${@bb.utils.contains('COMBINED_FEATURES', 'xen', 'xen', '', d)} \
"

IMAGE_INSTALL_append = " \
    ${@bb.utils.contains('COMBINED_FEATURES', 'jailhouse', 'jailhouse', '', d)} \
    ${@bb.utils.contains('MACHINE_FEATURES', 'optee', 'packagegroup-fsl-optee-imx', '', d)} \
    ${@bb.utils.contains('COMBINED_FEATURES', 'xen', 'imx-xen xen-tools', '', d)} \
"

MACHINE_FEATURES_append_imx    = " nxp8987"

# Overrides for all MACHINE.conf with optee support
UBOOT_CONFIG_OPTEE_CONFIG = "mx${OPTEE_BIN_EXT}_optee_config"
UBOOT_CONFIG[sd-optee] = "${UBOOT_CONFIG_OPTEE_CONFIG},sdcard"


# LF still doesn't support wireless now, need to remove it temporarily
# qca9377 is not ready for imx8mmevk
MACHINE_FEATURES_remove = "qca9377 mrvl8997"
```

## conf/machine/pitximx8mp2gdesktop.conf
```bitbake
MACHINE="pitximx8mp2g"
require conf/machine/pitximx8mp2g.conf

require conf/machine/include/ubuntubasics.inc
```

## conf/machine/pitximx8mp4gdesktop.conf
```bitbake
MACHINE="pitximx8mp4g"
require conf/machine/pitximx8mp4g.conf

require conf/machine/include/ubuntubasics.inc
```

## conf/machine/pitximx8mp6gdesktop.conf
```bitbake
MACHINE="pitximx8mp6g"
require conf/machine/pitximx8mp6g.conf

require conf/machine/include/ubuntubasics.inc
```

## conf/machine/smarcfimx6qp1g.conf
```bitbake
#@TYPE: Machine
#@NAME: EMBEDIAN i.MX6Q Plus SMARC CPU Card
#@SOC: i.MX6QP
#@DESCRIPTION: Machine configuration for Embedian i.MX6QP SMARC CPU Card 1GB DDR3L
#@MAINTAINER: Eric Lee <eric.lee@embedian.com>

MACHINEOVERRIDES =. "mx6:mx6q:"

require conf/machine/include/imx-base.inc
require conf/machine/include/arm/armv7a/tune-cortexa9.inc

SERIAL_CONSOLES = "115200;ttymxc4"

MACHINE_FIRMWARE:append = " linux-firmware-ath10k"

MACHINE_FEATURES += " pci wifi bluetooth screen usbgadget vfat ext2 alsa serial usbhost nxp8997-pcie"

IMAGE_FEATURES += "package-management"

MACHINE_GSTREAMER_1_0_PLUGIN:mx6q-nxp-bsp   ?= "gstreamer1.0-plugins-imx-meta"

PREFERRED_PROVIDER_virtual/kernel:use-nxp-bsp ??= "linux-imx"

KERNEL_DEVICETREE = "imx6qp-smarc.dtb \
                     imx6qp-smarc-wvga.dtb \
                     imx6qp-smarc-xga.dtb \
                     imx6qp-smarc-wxga.dtb \
                     imx6qp-smarc-1080p.dtb \
                     "

PREFERRED_PROVIDER_u-boot:use-nxp-bsp = "u-boot-imx"
PREFERRED_PROVIDER_virtual/bootloader:use-nxp-bsp = "u-boot-imx"

UBOOT_CONFIG ??= "sd"
UBOOT_CONFIG[sd] = "smarcfimx6_quadplus_1g_ser3_defconfig,sdcard"

OPTEE_BIN_EXT = "6qpsmarc"

MACHINE_EXTRA_RRECOMMENDS += " \
	u-boot-imx \
	packagegroup-tools-bluetooth \
	pm-utils \
	kmod \
	hdparm \
	gptfdisk \
	lftp \
	vim \
	ntp \
	boost \
	nodejs \
	android-tools \
	v4l-utils \
	imx-gst1.0-plugin \
"

IMAGE_INSTALL:append = " \
	firmware-imx-sdma-imx7d \
	firmware-imx-sdma-imx6q \
	firmware-imx-vpu-imx6q \
	firmware-imx-epdc \
	firmware-nxp-wifi-nxp8997-pcie \
	kernel-module-nxp-wlan \
	nxp-wlan-sdk \
	ppp \
	usb-modeswitch-data \
	usb-modeswitch \
"

IMAGE_FSTYPES = "tar.bz2"
```

## conf/machine/smarcfimx6qp2g.conf
```bitbake
#@TYPE: Machine
#@NAME: EMBEDIAN i.MX6Q Plus SMARC CPU Card
#@SOC: i.MX6QP
#@DESCRIPTION: Machine configuration for Embedian i.MX6Q Plus SMARC CPU Card 2GB DDR3L
#@MAINTAINER: Eric Lee <eric.lee@embedian.com>

MACHINEOVERRIDES =. "mx6:mx6q:"

include conf/machine/include/imx6sabresd-common.inc

SERIAL_CONSOLES = "115200;ttymxc4"

MACHINE_FIRMWARE:append = " linux-firmware-ath10k"

MACHINE_FEATURES += " pci wifi bluetooth screen usbgadget vfat ext2 alsa serial usbhost nxpwifi-all-pcie"

IMAGE_FEATURES += "package-management"

PREFERRED_PROVIDER_virtual/kernel:use-nxp-bsp ??= "linux-imx"

KERNEL_DEVICETREE = " \
    embedian/imx/imx6qp-smarc.dtb \
    embedian/imx/imx6qp-smarc-wvga.dtb \
    embedian/imx/imx6qp-smarc-xga.dtb \
    embedian/imx/imx6qp-smarc-wxga.dtb \
    embedian/imx/imx6qp-smarc-1080p.dtb \
"

PREFERRED_PROVIDER_u-boot:use-nxp-bsp = "u-boot-imx"
PREFERRED_PROVIDER_virtual/bootloader:use-nxp-bsp = "u-boot-imx"

UBOOT_CONFIG ??= "sd"
UBOOT_CONFIG[sd] = "smarcfimx6_quadplus_2g_ser3_defconfig,sdcard"

OPTEE_BIN_EXT = "6qpsmarc"

MACHINE_EXTRA_RRECOMMENDS += " \
	u-boot-imx \
	packagegroup-tools-bluetooth \
	pm-utils \
	kmod \
	hdparm \
	gptfdisk \
	lftp \
	vim \
	ntp \
	boost \
	nodejs \
	android-tools \
	v4l-utils \
	imx-gst1.0-plugin \
"

IMAGE_INSTALL:append = " \
	firmware-imx-sdma-imx7d \
	firmware-imx-sdma-imx6q \
	firmware-imx-vpu-imx6q \
	firmware-nxp-wifi-all-pcie \
	kernel-module-nxp-wlan \
	nxp-wlan-sdk \
	ppp \
	usb-modeswitch-data \
	usb-modeswitch \
"

IMAGE_FSTYPES = "tar.bz2"
```

## conf/machine/smarcfimx6solo.conf
```bitbake
#@TYPE: Machine
#@NAME: EMBEDIAN i.MX6Solo SMARC CPU Card
#@SOC: i.MX6S
#@DESCRIPTION: Machine configuration for Embedian i.MX6Solo SMARC CPU Card
#@MAINTAINER: Eric Lee <eric.lee@embedian.com>

MACHINEOVERRIDES =. "mx6:mx6dl:"

require conf/machine/include/imx-base.inc
require conf/machine/include/arm/armv7a/tune-cortexa9.inc

SERIAL_CONSOLES = "115200;ttymxc4"

MACHINE_FIRMWARE:append:mx6-nxp-bsp = " linux-firmware-ath10k"

MACHINE_FEATURES += " pci wifi bluetooth screen usbgadget vfat ext2 alsa serial usbhost nxp8997-pcie"

IMAGE_FEATURES += "package-management"

MACHINE_GSTREAMER_1_0_PLUGIN:mx6dl-nxp-bsp   ?= "gstreamer1.0-plugins-imx-meta"

PREFERRED_PROVIDER_virtual/kernel:use-nxp-bsp ??= "linux-imx"

KERNEL_DEVICETREE = "imx6dl-smarc.dtb \
                     imx6dl-smarc-wvga.dtb \
                     imx6dl-smarc-xga.dtb \
                     imx6dl-smarc-wxga.dtb \
                     imx6dl-smarc-1080p.dtb \
                     "

PREFERRED_PROVIDER_u-boot:use-nxp-bsp = "u-boot-imx"
PREFERRED_PROVIDER_virtual/bootloader:use-nxp-bsp = "u-boot-imx"

UBOOT_CONFIG ??= "sd"
UBOOT_CONFIG[sd] = "smarcfimx6_solo_ser3_defconfig,sdcard"

OPTEE_BIN_EXT = "6solosmarc"

MACHINE_EXTRA_RRECOMMENDS += " \
	u-boot-imx \
	packagegroup-tools-bluetooth \
	pm-utils \
	kmod \
	hdparm \
	gptfdisk \
	lftp \
	vim \
	ntp \
	boost \
	nodejs \
	android-tools \
	v4l-utils \
	imx-gst1.0-plugin \
"

IMAGE_INSTALL:append = " \
	firmware-imx-sdma-imx7d \
	firmware-imx-sdma-imx6q \
	firmware-imx-vpu-imx6d  \
	firmware-imx-epdc \
	firmware-nxp-wifi-nxp8997-pcie \
	kernel-module-nxp-wlan \
	nxp-wlan-sdk \
	ppp \
	usb-modeswitch-data \
	usb-modeswitch \
"

IMAGE_FSTYPES = "tar.bz2"
```
