## conf/machine/smarcimx8mm2gdesktop.conf
```bitbake
MACHINE="smarcimx8mm2g"
require conf/machine/smarcimx8mm2g.conf

require conf/machine/include/ubuntubasics.inc
```

## conf/machine/smarcimx8mm4gdesktop.conf
```bitbake
MACHINE="smarcimx8mm4g"
require conf/machine/smarcimx8mm4g.conf

require conf/machine/include/ubuntubasics.inc
```

## conf/machine/smarcimx8mp2gdesktop.conf
```bitbake
MACHINE="smarcimx8mp2g"
require conf/machine/smarcimx8mp2g.conf

require conf/machine/include/ubuntubasics.inc
```

## conf/machine/smarcimx8mp4g.conf
```bitbake
#@TYPE: Machine
#@NAME: EMBEDIAN SMARC-iMX8MP CPU Module with 4GB LPDDR4
#@SOC: i.MX8MP
#@DESCRIPTION: Machine configuration for Embedian SMARC-iMX8MP
#@MAINTAINER: Eric Lee <eric.lee@embedian.com>

MACHINEOVERRIDES =. "mx8:mx8m:mx8mp:"

require conf/machine/include/imx-base.inc
require conf/machine/include/tune-cortexa53.inc
require conf/machine/include/smarc-common.inc

MACHINE_FEATURES += " usbgadget vfat ext2 alsa serial pci wifi bluetooth optee nxp8997"

IMAGE_FEATURES += "package-management"

# Embedian BSP default providers
PREFERRED_PROVIDER_virtual/kernel_smarcimx8mp4g ?= "linux-smarcimx8mp"
PREFERRED_VERSION_linux-smarcimx8mp4g_smarcimx8mp4g = "5.10"

KERNEL_DEVICETREE = " \
                     embedian/imx8mp-smarc.dtb \
                     embedian/imx8mp-smarc-hdmi.dtb  \
                     embedian/imx8mp-smarc-lvds.dtb  \
                     embedian/imx8mp-smarc-m7.dtb \
"

WKS_FILE_DEPENDS_append = " imx-m7-demos"
IMAGE_BOOT_FILES += "imx8mp_m7_TCM_hello_world.bin \
                    imx8mp_m7_TCM_rpmsg_lite_pingpong_rtos_linux_remote.bin \
                    imx8mp_m7_TCM_rpmsg_lite_str_echo_rtos.bin \
"

PREFERRED_PROVIDER_u-boot_smarcimx8mp4g = "u-boot-smarcimx8mp"
PREFERRED_PROVIDER_virtual/bootloader_smarcimx8mp4g = "u-boot-smarcimx8mp"

UBOOT_CONFIG ??= "sd"
UBOOT_CONFIG[sd] = "smarcimx8mp_4g_ser3_defconfig,sdcard"
SPL_BINARY = "spl/u-boot-spl.bin"

# Set DDR FIRMWARE
DDR_FIRMWARE_NAME = "lpddr4_pmu_train_1d_dmem_202006.bin lpddr4_pmu_train_1d_imem_202006.bin lpddr4_pmu_train_2d_dmem_202006.bin lpddr4_pmu_train_2d_imem_202006.bin"

# Set u-boot DTB
UBOOT_DTB_NAME = "imx8mp-smarc.dtb"

# Set imx-mkimage boot target
IMXBOOT_TARGETS = "flash_evk"

# Set Serial console
SERIAL_CONSOLES = "115200;ttymxc1"

IMAGE_BOOTLOADER = "imx-boot"

LOADADDR = ""
UBOOT_SUFFIX = "bin"
UBOOT_MAKE_TARGET = ""
IMX_BOOT_SEEK = "32"

OPTEE_BIN_EXT = "8mp"

MACHINE_EXTRA_RDEPENDS += " \
			   imx-boot \
                           packagegroup-tools-bluetooth \
                           pm-utils \
                           kmod \
                           hdparm \
                           gptfdisk \
                           lftp \
                           vim \
                           ntp \
                           boost \
                           nodejs \
                           networkmanager \
			   android-tools \
                           "

# eIQ Machine Learning. Note that many of the features require Qt 5. Disable
# this when you build image without QT 5.
IMAGE_INSTALL_append = " \
	packagegroup-imx-ml \
	firmware-imx-sdma \
	firmware-imx-regulatory \
	fsl-rc-local \
        "

#TOOLCHAIN_TARGET_TASK_append += " tensorflow-lite-staticdev tensorflow-lite-dev armnn-dev onnxruntimedev"

IMAGE_FSTYPES = "tar.bz2"

# Ship all kernel modules by default
MACHINE_EXTRA_RRECOMMENDS = "kernel-modules"

# Add additional firmware
MACHINE_FIRMWARE_append = " linux-firmware-ath10k"
```

## conf/machine/smarcimx8mp4gdesktop.conf
```bitbake
MACHINE="smarcimx8mp4g"
require conf/machine/smarcimx8mp4g.conf

require conf/machine/include/ubuntubasics.inc
```

## conf/machine/smarcimx8mp6gdesktop.conf
```bitbake
MACHINE="smarcimx8mp6g"
require conf/machine/smarcimx8mp6g.conf

require conf/machine/include/ubuntubasics.inc
```

## conf/machine/smarcimx8mq2gdesktop.conf
```bitbake
MACHINE="smarcimx8mq2g"
require conf/machine/smarcimx8mq2g.conf

require conf/machine/include/ubuntubasics.inc
```

## conf/machine/smarcimx8mq4g.conf
```bitbake
#@TYPE: Machine
#@NAME: EMBEDIAN i.MX 8M Quad CPU Module with 4GB LPDDR4
#@SOC: i.MX8MQ
#@DESCRIPTION: Machine configuration for NXP i.MX 8M Quad CPU Module
#@MAINTAINER: Eric Lee <eric.lee@embedian.com>

MACHINEOVERRIDES =. "mx8mq:"

require conf/machine/include/imx-base.inc
require conf/machine/include/arm/armv8a/tune-cortexa53.inc

# Mainline BSP defaults to "generic" cortexa53 configuration,
# adjust it here to include crypto extension which enables
# inline NEON and FPU code generation
DEFAULTTUNE:use-mainline-bsp = "cortexa53-crypto"

MACHINE_FEATURES += "pci wifi bluetooth usbgadget vfat ext2 alsa serial nxp8997-pcie nxp9098-pcie package-management"
MACHINE_FEATURES:append:use-nxp-bsp = " jailhouse"

MACHINE_SOCARCH_FILTER:append:mx8mq = " virtual/libopenvg virtual/libgles1 virtual/libgles2 virtual/egl virtual/mesa virtual/libgl virtual/libg2d"

PREFERRED_PROVIDER_virtual/kernel:use-nxp-bsp ??= "linux-imx"

# The device tree name is implicit for LPDDR4, so can't use MACHINE here
KERNEL_DEVICETREE_BASENAME = "imx8mq-smarc"

KERNEL_DEVICETREE = " \
	embedian/${KERNEL_DEVICETREE_BASENAME}.dtb \
"
KERNEL_DEVICETREE:append:use-nxp-bsp = " \
	embedian/${KERNEL_DEVICETREE_BASENAME}-hdmi.dtb \
	embedian/${KERNEL_DEVICETREE_BASENAME}-dp.dtb \
	embedian/${KERNEL_DEVICETREE_BASENAME}-dcss-lvds.dtb \
	embedian/${KERNEL_DEVICETREE_BASENAME}-lcdif-lvds.dtb \
	embedian/${KERNEL_DEVICETREE_BASENAME}-dual-display.dtb \
	embedian/${KERNEL_DEVICETREE_BASENAME}-m4.dtb \
	embedian/${KERNEL_DEVICETREE_BASENAME}-m4-hdmi.dtb \
	embedian/${KERNEL_DEVICETREE_BASENAME}-m4-dp.dtb \
	embedian/${KERNEL_DEVICETREE_BASENAME}-m4-dcss-lvds.dtb \
	embedian/${KERNEL_DEVICETREE_BASENAME}-m4-lcdif-lvds.dtb \
	embedian/${KERNEL_DEVICETREE_BASENAME}-m4-dual-display.dtb \
"

PREFERRED_PROVIDER_u-boot:use-nxp-bsp = "u-boot-imx"
PREFERRED_PROVIDER_virtual/bootloader:use-nxp-bsp = "u-boot-imx"

UBOOT_SUFFIX = "bin"

UBOOT_CONFIG ??= "sd"
UBOOT_CONFIG_BASENAME = "smarcimx8mq"
UBOOT_CONSOLE_BASENAME = "ser3"
LPDDR4_BASENAME = "4g"
UBOOT_CONFIG[sd]       ="${UBOOT_CONFIG_BASENAME}_${LPDDR4_BASENAME}_${UBOOT_CONSOLE_BASENAME}_defconfig,sdcard" 

SPL_BINARY = "spl/u-boot-spl.bin"

# Set DDR FIRMWARE
DDR_FIRMWARE_NAME = " \
    lpddr4_pmu_train_1d_imem.bin \
    lpddr4_pmu_train_1d_dmem.bin \
    lpddr4_pmu_train_2d_imem.bin \
    lpddr4_pmu_train_2d_dmem.bin \
"

# Set u-boot DTB
UBOOT_DTB_NAME = "imx8mq-smarc.dtb"

# Set ATF platform name
ATF_PLATFORM = "imx8mq"

# Set imx-mkimage boot target
IMXBOOT_TARGETS = "flash_evk flash_evk_no_hdmi flash_dp_evk"
IMX_BOOT_SOC_TARGET = "iMX8M"

# Set Serial console
SERIAL_CONSOLES = "115200;ttymxc0"

LOADADDR = ""
UBOOT_MAKE_TARGET = ""
IMX_BOOT_SEEK = "33"

OPTEE_BIN_EXT = "8mq"

# Add additional firmware
MACHINE_FIRMWARE:append = " linux-firmware-ath10k"

WKS_FILE_DEPENDS:append = " imx-m4-demos"
IMAGE_BOOT_FILES:append = " \
	mcore-demos/imx8mq_m4_TCM_hello_world.bin \
	mcore-demos/imx8mq_m4_TCM_rpmsg_lite_pingpong_rtos_linux_remote.bin \
	mcore-demos/imx8mq_m4_TCM_rpmsg_lite_str_echo_rtos.bin \
"

MACHINE_EXTRA_RRECOMMENDS += " \
	imx-boot \
	packagegroup-tools-bluetooth \
	pm-utils \
	kmod \
	hdparm \
	gptfdisk \
	lftp \
	vim \
	ntp \
	boost \
	nodejs \
	android-tools \
	v4l-utils \
	imx-gst1.0-plugin \
"

IMAGE_INSTALL:append = " \
	firmware-imx-sdma-imx7d \
	firmware-nxp-wifi-nxp8997-pcie \
	firmware-nxp-wifi-nxp9098-pcie \
	firmware-nxp-wifi-all-pcie \
	kernel-module-nxp-wlan \
	nxp-wlan-sdk \
	ppp \
	usb-modeswitch-data \
	usb-modeswitch \
"

IMAGE_FSTYPES = "tar.bz2"
```

## conf/machine/smarcimx8mq4gdesktop.conf
```bitbake
MACHINE="smarcimx8mq4g"
require conf/machine/smarcimx8mq4g.conf

require conf/machine/include/ubuntubasics.inc
```

## conf/machine/smarcimx8qm4g.conf
```bitbake
#@TYPE: Machine
#@NAME: i.MX 8QM CPU Module with 4GB LPDDR4
#@SOC: i.MX8QM
#@DESCRIPTION: Machine configuration for Embedian i.MX 8QuadMax SMARC Module
#@MAINTAINER: Eric Lee <eric.lee@embedian.com>

MACHINEOVERRIDES =. "mx8:mx8qm:"

require conf/machine/include/imx-base.inc
require conf/machine/include/arm/armv8a/tune-cortexa72-cortexa53.inc

IMX_DEFAULT_BSP = "nxp"

MACHINE_FEATURES += "wifi bluetooth usbgadget vfat ext2 alsa serial pci nxp8997-pcie nxp9098-pcie nxpwifi-all-pcie nxpwifi-all-sdio package-management"
MACHINE_FEATURES:append:use-nxp-bsp = " optee"

# Don't include kernels in standard images
RRECOMMENDS:${KERNEL_PACKAGE_NAME}-base = ""

RDEPENDS:${KERNEL_PACKAGE_NAME}-image = ""

PREFERRED_PROVIDER_virtual/kernel:use-nxp-bsp ??= "linux-imx"

LOADADDR = ""

# We have to disable SERIAL_CONSOLE due to auto-serial-console
SERIAL_CONSOLES = "115200;ttyAMA0"

# we do not want to have getty running on tty1 as we run
# auto-serial-console there
USE_VT = "0"

KERNEL_DEVICETREE = " \
	embedian/imx8qm-smarc.dtb \
	embedian/imx8qm-smarc-lvds.dtb \
	embedian/imx8qm-smarc-hdmi.dtb \
	embedian/imx8qm-smarc-dp.dtb \
	embedian/imx8qm-smarc-rpmsg.dtb \
	embedian/imx8qm-smarc-edp.dtb \
"

PREFERRED_PROVIDER_u-boot:use-nxp-bsp = "u-boot-imx"
PREFERRED_PROVIDER_virtual/bootloader:use-nxp-bsp = "u-boot-imx"

# Set u-boot DTB
UBOOT_DTB_NAME = "imx8qm-smarc.dtb"

UBOOT_MAKE_TARGET = ""
SPL_BINARY = "spl/u-boot-spl.bin"

UBOOT_SUFFIX = "bin"

UBOOT_CONFIG_BASENAME = "smarcimx8qm"
UBOOT_CONSOLE_BASENAME = "ser3"
LPDDR4_BASENAME = "4g"
UBOOT_CONFIG ??= "sd"
UBOOT_CONFIG[sd]      = "${UBOOT_CONFIG_BASENAME}_${LPDDR4_BASENAME}_${UBOOT_CONSOLE_BASENAME}_defconfig,sdcard"

IMX_BOOT_SEEK = "32"

IMAGE_BOOT_FILES += "hdmitxfw.bin hdmirxfw.bin dpfw.bin"

# Set ATF platform name
ATF_PLATFORM = "imx8qm"

IMXBOOT_TARGETS = "flash_linux_m4"

IMX_BOOT_SOC_TARGET = "iMX8QM"

BOARD_TYPE = "smarc-4g"

# Add additional firmware
MACHINE_FIRMWARE:append = " linux-firmware-ath10k"

MACHINE_EXTRA_RRECOMMENDS += " \
	imx-boot \
	packagegroup-tools-bluetooth \
	pm-utils \
	kmod \
	hdparm \
	gptfdisk \
	lftp \
	vim \
	ntp \
	boost \
	nodejs \
	android-tools \
	v4l-utils \
	imx-gst1.0-plugin \
"

IMAGE_INSTALL:append = " \
	firmware-imx-sdma-imx7d \
	firmware-imx-hdmi \
	firmware-imx-xuvi-imx8 \
	sof-zephyr \
	zephyr-demo-imx \
	firmware-nxp-wifi-nxp8997-pcie \
	firmware-nxp-wifi-nxp9098-pcie \
	firmware-nxp-wifi-all-sdio \
	firmware-nxp-wifi-all-pcie \
	nxp-wlan-sdk \
	kernel-module-nxp-wlan \
	ppp \
	usb-modeswitch-data \
	usb-modeswitch \
"

IMAGE_FSTYPES = "tar.bz2"
```

## conf/machine/smarcimx8qm4gdesktop.conf
```bitbake
MACHINE="smarcimx8qm4g"
require conf/machine/smarcimx8qm4g.conf

require conf/machine/include/ubuntubasics.inc
```

## conf/machine/smarcimx8qm8gdesktop.conf
```bitbake
MACHINE="smarcimx8qm8g"
require conf/machine/smarcimx8qm8g.conf

require conf/machine/include/ubuntubasics.inc
```

## conf/machine/smarcimx932g.conf
```bitbake
#@TYPE: Machine
#@NAME: EMBEDIAN i.MX 93 SMARC Module with 2GB LPDDR4X
#@SOC: i.MX93
#@DESCRIPTION: Machine configuration for EMBEDIAN i.MX 93 CPU Module with 2GB LPDDR4X
#@MAINTAINER: ERic Lee <eric.lee@nxp.com>

MACHINEOVERRIDES =. "mx93:"

require conf/machine/include/imx-base.inc
require conf/machine/include/arm/armv8-2a/tune-cortexa55.inc

PREFERRED_PROVIDER_virtual/kernel:use-nxp-bsp ??= "linux-imx"

KERNEL_DEVICETREE_BASENAME = "imx93-smarc"

KERNEL_DEVICETREE = " \
	embedian/${KERNEL_DEVICETREE_BASENAME}.dtb \
"

PREFERRED_PROVIDER_u-boot:use-nxp-bsp = "u-boot-imx"
PREFERRED_PROVIDER_virtual/bootloader:use-nxp-bsp = "u-boot-imx"

LOADADDR = ""
UBOOT_SUFFIX = "bin"
UBOOT_MAKE_TARGET = ""

SPL_BINARY = "spl/u-boot-spl.bin"

UBOOT_CONFIG_BASENAME = "smarcimx93"
UBOOT_CONSOLE_BASENAME = "ser3"
LPDDR4_BASENAME = "2g"
UBOOT_CONFIG ??= "sd"
UBOOT_CONFIG[sd] = "${UBOOT_CONFIG_BASENAME}_${LPDDR4_BASENAME}_${UBOOT_CONSOLE_BASENAME}_defconfig,sdcard"

# Set ATF platform name
ATF_PLATFORM = "imx93"

IMX_BOOT_SOC_TARGET = "iMX9"
IMXBOOT_TARGETS = "flash_singleboot"
IMXBOOT_TARGETS_BASENAME = "flash_singleboot"
IMX_BOOT_SEEK = "32"

DDR_FIRMWARE_NAME = " \
    lpddr4_dmem_1d_v202201.bin \
    lpddr4_dmem_2d_v202201.bin \
    lpddr4_imem_1d_v202201.bin \
    lpddr4_imem_2d_v202201.bin \
"

# Set Serial console
SERIAL_CONSOLES = "115200;ttyLP0"

IMX_DEFAULT_BSP = "nxp"

MACHINE_FEATURES += "pci wifi bluetooth usbgadget vfat ext2 alsa serial dpdk nxpwifi-all-sdio package-management"
MACHINE_FEATURES:append:use-nxp-bsp = " optee jailhouse nxpiw612-sdio"
MACHINE_FIRMWARE:append = " ethos-u-firmware"
WKS_FILE_DEPENDS:append = " imx-m33-demos"

MACHINE_EXTRA_RRECOMMENDS += " \
	imx-boot \
	packagegroup-tools-bluetooth \
	pm-utils \
	kmod \
	hdparm \
	gptfdisk \
	lftp \
	vim \
	ntp \
	boost \
	nodejs \
	android-tools \
	v4l-utils \
	imx-gst1.0-plugin \
"

IMAGE_INSTALL:append = " \
	firmware-nxp-wifi-all-sdio \
	firmware-nxp-wifi-nxpiw612-sdio \
	nxp-wlan-sdk \
	wpa-supplicant \
	iw \
	wireless-regdb \
	libnl \
	busybox \
	kernel-module-nxp-wlan \
	ppp \
	usb-modeswitch-data \
	usb-modeswitch \
	linuxptp \
	iproute2 \
	rfkill \
	ethtool \
	lldpd \
	tsntool \
	kernel-modules \
"

PACKAGECONFIG:append:pn-lldpd = " nl80211"

# Add package
IGH_ETHERCAT ??= " "
IGH_ETHERCAT:pitximx8mp2g = " fec "
PACKAGECONFIG:append:pn-igh-ethercat = " ${IGH_ETHERCAT} "
IMAGE_INSTALL += " igh-ethercat "

# Add package
REAL_TIME_EDGE_SYSREPO:pitximx8mp2g = ""
PACKAGECONFIG:append:pn-real-time-edge-sysrepo = "${REAL_TIME_EDGE_SYSREPO}"
IMAGE_INSTALL:append = " real-time-edge-sysrepo "

# Add package
# Select OPC UA example application
include ${BSPDIR}/sources/meta-real-time-edge/conf/distro/include/libopen62541.inc
LIBOPEN62541_LOGLEVE = "300"
IMAGE_INSTALL += " libopen62541 "

IMAGE_FSTYPES = "tar.bz2"
```
